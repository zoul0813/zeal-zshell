## Kconfig
```kconfig
mainmenu "ZShell Configuration"

menu "Features"

config AUTOEXEC_ENABLED
    bool "Enable autoexec processing"
    default y
    help
      Enable automatic execution of startup commands.

config HISTORY_ENABLED
    bool "Enable command history"
    default y
    help
      Enable command history functionality.

config COLOR_SUPPORT
    bool "Enable color support"
    default y
    help
      Enable ANSI color support in the shell.

config AUTOEXEC_FILENAME
    string "Autoexec filename"
    depends on AUTOEXEC_ENABLED
    default "B:/autoexec.zs"
    help
      Path and filename for the autoexec script that will be
      automatically executed at shell startup.


endmenu

menu "Built-in Commands"

config BUILTIN_HASH
    bool "Enable # status command"
    default y

config BUILTIN_PWD
    bool "Enable pwd command"
    default y

config BUILTIN_EXIT
    bool "Enable exit command"
    default y

config BUILTIN_EXEC
    bool "Enable exec command"
    default y

config BUILTIN_CLEAR
    bool "Enable clear command"
    default y

config BUILTIN_WHICH
    bool "Enable which command"
    default y

config BUILTIN_TRUE
    bool "Enable true command"
    default y

config BUILTIN_FALSE
    bool "Enable false command"
    default y

config BUILTIN_VER
    bool "Enable ver command"
    default y

config BUILTIN_RESET
    bool "Enable reset command"
    default y

endmenu

menu "Buffer and Memory Settings"

config COMMAND_MAX
    int "Maximum command buffer size"
    default 256
    range 64 256
    help
      Maximum size of the command input buffer in bytes.

config MAX_PATHS
    int "Maximum number of paths"
    default 8
    range 1 16
    help
      Maximum number of paths that can be stored in the shell.

config BATCH_MAX_DEPTH
    int "Maximum nested batch depth"
    default 4
    range 1 16
    help
      Maximum number of batch scripts that may be active at once.

config HISTORY_MAX_ENTRIES
    int "Maximum history entries"
    depends on HISTORY_ENABLED
    default 10
    range 1 32
    help
      Maximum number of command history entries to keep.

endmenu
```
